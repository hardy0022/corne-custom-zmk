#include <dt-bindings/zmk/matrix_transform.h>

/ {
    // Left Encoder Definition (B4 / B5)
    left_encoder: encoder_left {
        compatible = "alps,ec11";
        a-gpios = <&pro_micro 8 (GPIO_ACTIVE_LOW | GPIO_PULL_UP)>; // B4
        b-gpios = <&pro_micro 9 (GPIO_ACTIVE_LOW | GPIO_PULL_UP)>; // B5
        steps = <80>;
        status = "okay";
    };

    sensors: sensors {
        compatible = "zmk,keymap-sensors";
        sensors = <&left_encoder>;
        triggers-per-rotation = <20>;
    };

    // Left Encoder Push Button (E6)
    kscan0: kscan_left {
        compatible = "zmk,kscan-gpio-direct";
        wakeup-source;
        input-gpios = <&pro_micro 7 (GPIO_ACTIVE_LOW | GPIO_PULL_UP)>; // E6
    };
};

&left_encoder {
    status = "okay";
};
