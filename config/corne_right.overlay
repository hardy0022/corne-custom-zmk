#include <dt-bindings/zmk/matrix_transform.h>

/ {
    // Right Encoder Definition (B4 / B5)
    right_encoder: encoder_right {
        compatible = "alps,ec11";
        a-gpios = <&pro_micro 8 (GPIO_ACTIVE_LOW | GPIO_PULL_UP)>; // B4
        b-gpios = <&pro_micro 9 (GPIO_ACTIVE_LOW | GPIO_PULL_UP)>; // B5
        steps = <80>;
        status = "okay";
    };

    sensors: sensors {
        compatible = "zmk,keymap-sensors";
        sensors = <&right_encoder>;
        triggers-per-rotation = <20>;
    };

    // Right Encoder Push Button (F7)
    kscan0: kscan_right {
        compatible = "zmk,kscan-gpio-direct";
        wakeup-source;
        input-gpios = <&pro_micro 18 (GPIO_ACTIVE_LOW | GPIO_PULL_UP)>; // F7
    };
};

&right_encoder {
    status = "okay";
};
